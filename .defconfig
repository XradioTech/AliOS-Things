## platform/board/xr808/Config.in
```kconfig
config AOS_BOARD_XR808
    bool "XR808"
    select AOS_MCU_XR808 if !AOS_CREATE_PROJECT
    select AOS_COMP_KERNEL_INIT if !AOS_CREATE_PROJECT
    select AOS_COMP_NETMGR if !AOS_CREATE_PROJECT
    select AOS_COMP_NEWLIB_STUB if !AOS_CREATE_PROJECT

    select AOS_COMP_YLOOP if !AOS_CREATE_PROJECT
    select AOS_COMP_CLI if !AOS_CREATE_PROJECT
    select AOS_COMP_FATFS if !AOS_CREATE_PROJECT
    select CONFIG_AOS_TCPIP

    help

if AOS_BOARD_XR808
# Configurations for board xr808

# "BSP SUPPORT FEATURE"
config BSP_SUPPORT_WIFI
    bool
    default y

endif
```

## platform/board/xr872/Config.in
```kconfig
config AOS_BOARD_XR872
    bool "XR872"
    select AOS_MCU_XR872 if !AOS_CREATE_PROJECT
    select AOS_COMP_KERNEL_INIT if !AOS_CREATE_PROJECT
    select AOS_COMP_NETMGR if !AOS_CREATE_PROJECT
    select AOS_COMP_NEWLIB_STUB if !AOS_CREATE_PROJECT

    select AOS_COMP_YLOOP if !AOS_CREATE_PROJECT
    select AOS_COMP_CLI if !AOS_CREATE_PROJECT
    select AOS_COMP_FATFS if !AOS_CREATE_PROJECT
    select CONFIG_AOS_TCPIP

    help

if AOS_BOARD_XR872
# Configurations for board xr872

# "BSP SUPPORT FEATURE"
config BSP_SUPPORT_WIFI
    bool
    default y

endif
```

## platform/mcu/xr808/Config.in
```kconfig
config AOS_MCU_XR808
    bool
    select AOS_ARCH_ARMV7M
    select AOS_COMP_RHINO

    help
      driver & sdk for platform/mcu xr808

if AOS_MCU_XR872
# Configurations for mcu xr808
endif
```

## platform/mcu/xr872/Config.in
```kconfig
config AOS_MCU_XR872
    bool
    select AOS_ARCH_ARMV7M
    select AOS_COMP_RHINO

    help
      driver & sdk for platform/mcu xr872

if AOS_MCU_XR872
# Configurations for mcu xr872
endif
```
